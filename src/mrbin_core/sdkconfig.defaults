## src/mrbin_core/sdkconfig.defaults
```kconfig
CONFIG_IDF_TARGET="esp32p4"
CONFIG_ESP_MAIN_TASK_STACK_SIZE=8192
CONFIG_FREERTOS_HZ=1000
CONFIG_IDF_EXPERIMENTAL_FEATURES=y

# Chip revision v1.x (Waveshare ESP32-P4-WIFI6-M = rev v1.3)
CONFIG_ESP32P4_SELECTS_REV_LESS_V3=y
CONFIG_ESP32P4_REV_MIN_100=y

// Flash / PSRAM (Waveshare ESP32-P4-WIFI6-M, 32 MB flash + 32 MB HEX PSRAM)
CONFIG_ESPTOOLPY_FLASHSIZE_32MB=y
CONFIG_SPIRAM=y
CONFIG_SPIRAM_SPEED_200M=y

# Partition table
CONFIG_PARTITION_TABLE_CUSTOM=y
CONFIG_PARTITION_TABLE_CUSTOM_FILENAME="partitions.csv"

# FatFS / SD
CONFIG_FATFS_LFN_HEAP=y
CONFIG_FATFS_MAX_LFN=255
CONFIG_VFS_MAX_COUNT=12

# Wi-Fi via ESP32-C6 slave (esp_hosted)
CONFIG_ESP_WIFI_REMOTE_ENABLED=y
CONFIG_ESP_HOSTED_IDF_SLAVE_TARGET="esp32c6"
CONFIG_SLAVE_IDF_TARGET_ESP32C6=y

# Camera OV5647 — 1280×960 binning (compromesso qualità / fps)
CONFIG_CAMERA_OV5647=y
# CONFIG_CAMERA_OV5647_MIPI_RAW8_800X640_50FPS is not set
# CONFIG_CAMERA_OV5647_MIPI_RAW10_1920X1080_30FPS is not set
CONFIG_CAMERA_OV5647_MIPI_RAW10_1280X960_BINNING_45FPS=y
CONFIG_CAMERA_OV5647_MIPI_DEFAULT_FMT_RAW10_1280X960_BINNING_45FPS=y
CONFIG_CAMERA_OV5647_MIPI_IF_FORMAT_INDEX_DEFAULT=4
CONFIG_ESP_VIDEO_ENABLE_ISP_PIPELINE_CONTROLLER=y
# CONFIG_ESP_VIDEO_ENABLE_DVP_VIDEO_DEVICE is not set

# Crypto
CONFIG_MBEDTLS_HARDWARE_AES=y

# Build
CONFIG_COMPILER_OPTIMIZATION_PERF=y
CONFIG_COMPILER_DISABLE_GCC14_WARNINGS=y
CONFIG_ESP_TASK_WDT_EN=n

# Fast boot (PIR / TPL5111 — registrazione prioritaria)
CONFIG_BOOTLOADER_LOG_LEVEL_NONE=y
CONFIG_BOOTLOADER_SKIP_VALIDATE_ON_POWER_ON=y
CONFIG_SPIRAM_MEMTEST=n

# IDF 6.x only: PicolibC (required by esp_ipa v6.0+ prebuilt libs)
# CONFIG_LIBC_PICOLIBC is not set
```
